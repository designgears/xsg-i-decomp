/* names accepted unit records use for scaffold-owned addresses (generated) */
PROVIDE(MoveHokanStateFlag = GameLoopState + 193);
PROVIDE(TestEnv4 = TestEnv_4_00369E10 + 0);
PROVIDE(TestEnv5 = TestEnv_5_00369E70 + 0);
PROVIDE(hdd_1024_directory_name = name_44 + 0);
PROVIDE(hdd_dummy_folder_name = name_45 + 0);
PROVIDE(hdd_test_menu = menu_46 + 0);
PROVIDE(UmnDataBaseStateData = SaveData + 66140);
PROVIDE(call_method_signature_void = sig_2 + 0);
PROVIDE(call_method_signature_int = sig_3 + 0);
PROVIDE(call_method_signature_int_int = sig_4 + 0);
PROVIDE(transfer_progress = size_68 + 0);
PROVIDE(callback_file_name = fname_67 + 0);
